## config/west.yml
```yaml
manifest:
  remotes:
    - name: zmkfirmware
      url-base: https://github.com/zmkfirmware
    # Additional modules containing boards/shields/custom code can be listed here as well
    # See https://docs.zephyrproject.org/3.2.0/develop/west/manifest.html#projects
    # Add my base URL as a remote
    - name: will-hedges
      url-base: https://github.com/will-hedges
  projects:
    - name: zmk
      remote: zmkfirmware
      revision: main
      import: app/west.yml
    # Add the name of the repository as a project
    - name: mf68-shield-module
      remote: will-hedges
      # revision is the name of the branch you want to use
      revision: main
  self:
    path: config
```
